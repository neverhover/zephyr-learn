## prj.conf
```kconfig
CONFIG_CONSOLE_PULL=y
CONFIG_CONSOLE_GETLINE=y
CONFIG_UART_STM32_PORT_1=y
```

## src/main.c
```c
/*
 * Copyright (c) 2017 Linaro Limited
 *
 * SPDX-License-Identifier: Apache-2.0
 */

#include <string.h>
#include <zephyr.h>
#include <misc/printk.h>
#include <console.h>

void main(void)
{
	console_getline_init();

	while (1) {
		printk("123123\n");
		char *s = console_getline();

		printk("line: %s\n", s);
		printk("last char was: 0x%x\n", s[strlen(s) - 1]);
		k_sleep(1000);
	}
}
```
